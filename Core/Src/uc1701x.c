/**
  ******************************************************************************
  * @file    uc1701x.c
  * @brief   JLX12864G-0088 (UC1701X) 드라이버 구현.
  *
  * 초기화 커맨드/지연 순서는 JLX12864G-0088 中文说明书 p.14 의
  * initial_lcd() 예제를 그대로 옮긴 것입니다 (curl 확인 2026-07-03).
  * 주소 지정: page = 0xB0|page, column = 0x10|(col>>4) + (col&0x0F).
  * SPI 모드 0 (CPOL=0, CPHA=1EDGE) — UC1701X 는 SCK 상승 에지에서 래치.
  ******************************************************************************
  */
#include "uc1701x.h"

static SPI_HandleTypeDef *uc1701x_hspi = NULL;

/* 표준 5x7 폰트, ASCII 0x20(' ') ~ 0x7E('~'), 글리프당 세로 5바이트 */
static const uint8_t uc1701x_font5x7[95][5] =
{
  {0x00, 0x00, 0x00, 0x00, 0x00}, /* ' ' */
  {0x00, 0x00, 0x5F, 0x00, 0x00}, /* '!' */
  {0x00, 0x07, 0x00, 0x07, 0x00}, /* '"' */
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  {0x08, 0x04, 0x08, 0x10, 0x08}, /* '~' */
};

static void uc1701x_select(void)
{
  HAL_GPIO_WritePin(UC1701X_CS_PORT, UC1701X_CS_PIN, GPIO_PIN_RESET);
}

static void uc1701x_deselect(void)
{
  HAL_GPIO_WritePin(UC1701X_CS_PORT, UC1701X_CS_PIN, GPIO_PIN_SET);
}

static void uc1701x_write_command(uint8_t cmd)
{
  HAL_GPIO_WritePin(UC1701X_DC_PORT, UC1701X_DC_PIN, GPIO_PIN_RESET); /* LOW = command */
  (void)HAL_SPI_Transmit(uc1701x_hspi, &cmd, 1U, 10U);
}

static void uc1701x_write_data(const uint8_t *data, uint16_t len)
{
  HAL_GPIO_WritePin(UC1701X_DC_PORT, UC1701X_DC_PIN, GPIO_PIN_SET);   /* HIGH = data */
  (void)HAL_SPI_Transmit(uc1701x_hspi, data, len, 100U);
}

/* page(0~7)/column(0~131) 주소 지정. 데이터시트 lcd_address() 대응 (0-based) */
static void uc1701x_set_address(uint8_t page, uint8_t column)
{
  uc1701x_write_command(0xB0U | (page & 0x0FU));
  uc1701x_write_command(0x10U | ((column >> 4) & 0x0FU));
  uc1701x_write_command(column & 0x0FU);
}

void uc1701x_init(SPI_HandleTypeDef *hspi)
{
  uc1701x_hspi = hspi;

  /* 하드웨어 리셋: /RESET low 100ms -> high 20ms (데이터시트 initial_lcd 순서) */
  HAL_GPIO_WritePin(UC1701X_RST_PORT, UC1701X_RST_PIN, GPIO_PIN_RESET);
  HAL_Delay(100);
  HAL_GPIO_WritePin(UC1701X_RST_PORT, UC1701X_RST_PIN, GPIO_PIN_SET);
  HAL_Delay(20);

  uc1701x_select();
  uc1701x_write_command(0xE2U); /* 소프트 리셋 */
  HAL_Delay(5);
  uc1701x_write_command(0x2CU); /* 승압 1단 */
  HAL_Delay(5);
  uc1701x_write_command(0x2EU); /* 승압 2단 */
  HAL_Delay(5);
  uc1701x_write_command(0x2FU); /* 승압 3단 */
  HAL_Delay(5);
  uc1701x_write_command(0x23U); /* 대비 거친 조정 (범위 0x20~0x27) */
  uc1701x_write_command(0x81U); /* 대비 미세 조정 프리픽스 */
  uc1701x_write_command(0x28U); /* 대비 미세 값 (범위 0x00~0x3F) */
  uc1701x_write_command(0xA2U); /* bias 1/9 */
  uc1701x_write_command(0xC8U); /* COM 스캔 방향: 위 -> 아래 */
  uc1701x_write_command(0xA0U); /* SEG 스캔 방향: 왼쪽 -> 오른쪽 */
  uc1701x_write_command(0x40U); /* 표시 시작 라인 0 */
  uc1701x_write_command(0xAFU); /* 표시 ON */
  uc1701x_deselect();
}

void uc1701x_clear(void)
{
  static const uint8_t zeros[UC1701X_RAM_COLS] = {0};

  uc1701x_select();
  for (uint8_t page = 0U; page < UC1701X_PAGES; page++)
  {
    uc1701x_set_address(page, 0U);
    uc1701x_write_data(zeros, UC1701X_RAM_COLS);
  }
  uc1701x_deselect();
}

void uc1701x_draw_string(uint8_t page, uint8_t x, const char *text)
{
  if ((uc1701x_hspi == NULL) || (page >= UC1701X_PAGES))
  {
    return;
  }

  uc1701x_select();
  uc1701x_set_address(page, x);
  while (*text != '\0')
  {
    if ((x + UC1701X_FONT_W) > UC1701X_WIDTH)
    {
      break; /* 화면 오른쪽 끝 초과분은 그리지 않음 */
    }

    unsigned char c = (unsigned char)*text;
    text++;
    if ((c < 0x20U) || (c > 0x7EU))
    {
      c = (unsigned char)'?';
    }

    uint8_t column_buf[UC1701X_FONT_W];
    for (uint8_t i = 0U; i < 5U; i++)
    {
      column_buf[i] = uc1701x_font5x7[c - 0x20U][i];
    }
    column_buf[5] = 0x00U; /* 글자 간 간격 1픽셀 */

    uc1701x_write_data(column_buf, UC1701X_FONT_W);
    x += UC1701X_FONT_W;
  }
  uc1701x_deselect();
}
